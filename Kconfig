## Kconfig
```kconfig
config AUFSNG_FS
	tristate "aufs-ng filesystem support (AUFS-compatible union filesystem)"
	depends on 64BIT
	select FS_STACK
	help
	  aufs-ng is a standalone, from-scratch union filesystem
	  compatible with many live Linux distributions. It registers
	  as filesystem type "aufs", using AUFS's own mount option
	  syntax and on-disk whiteout format, so that most scripts
	  issuing real AUFS mount/remount commands work unmodified.

	  Not supported: plink, dirren, shwh, RDU, more than one rw
	  branch, NFS export, FHSM and add= at any position other than
	  1.  Renaming a merged directory fails with EXDEV.

	  A live-boot sequence typically needs this filesystem type
	  mounted before any loadable module can be reached (the same
	  reason AUFS and overlayfs are usually built statically), so
	  this option should be built in ("Y"), not built as a loadable
	  module, wherever that applies. Say Y if you are building a
	  live-distro kernel that needs it; say N otherwise.

	  64-bit only: inode numbers carry the branch a file came from in
	  their high bits, which a 32-bit ino_t cannot hold.
```
